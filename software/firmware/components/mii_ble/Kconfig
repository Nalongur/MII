## software/firmware/components/mii_ble/Kconfig
```kconfig
menu "MII BLE control service"

config MII_BLE_CONTROL_SERVICE
    bool "Start the experimental BLE control service"
    depends on BT_NIMBLE_ENABLED
    default n
    help
        Start the MII V7 development GATT service after safe-output and protocol
        self-tests. The current link uses Secure Connections Just Works, which
        encrypts traffic but does not authenticate the peer against MITM.
        Keep disabled until pairing and application authorization are complete.

endmenu
```

## software/firmware/components/mii_protocol/Kconfig
```kconfig
menu "MII protocol"

config MII_PROTOCOL_STARTUP_SELF_TEST
    bool "Run fixed protocol self-tests at startup"
    default n
    help
        Compile and run allocation-free nanopb, session-state and stream-framing
        self-tests after the board safe outputs are initialized. Intended for
        development images; keep disabled in Release builds.

endmenu
```
